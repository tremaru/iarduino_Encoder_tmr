// ВЫВОДИМ НАПРАВЛЕНИЕ ПОВОРОТА С 2 ЭНКОДЕРОВ:   //
// Поворот по     чс: Выводим '<'.               //
// Поворот против чс: Выводим '>'.               //  Если перепутать выводы A и B, то выводимые символы поменяются местами.
                                                 //
uint8_t pin_1A = 7;                              //  Вывод Arduino подключённый к выводу A энкодера 1 (можно использовать любые выводы).
uint8_t pin_1B = 8;                              //  Вывод Arduino подключённый к выводу B энкодера 1 (можно использовать любые выводы).
uint8_t pin_2A = 11;                             //  Вывод Arduino подключённый к выводу A энкодера 2 (можно использовать любые выводы).
uint8_t pin_2B = 12;                             //  Вывод Arduino подключённый к выводу B энкодера 2 (можно использовать любые выводы).
                                                 //
#include <iarduino_Encoder_tmr.h>                //  Подключаем библиотеку iarduino_Encoder_tmr для работы с энкодерами через аппаратный таймер
iarduino_Encoder_tmr enc_1(pin_1A,pin_1B);       //  Объявляем объект enc_1 для работы с 1 энкодером указывая (№ вывода A, № вывода B)
iarduino_Encoder_tmr enc_2(pin_2A,pin_2B);       //  Объявляем объект enc_2 для работы с 2 энкодером указывая (№ вывода A, № вывода B)
                                                 //  При использовании библиотеки iarduino_Encoder_tmr можно подключить до 8 энкодеров.
void setup(){                                    //
     Serial.begin(9600);                         //  Инициируем передачу данных в монитор последовательного порта на скорости 9600 бит/сек.
     enc_1.begin();                              //  Инициируем работу с 1 энкодером.
     enc_2.begin();                              //  Инициируем работу с 2 энкодером.
}                                                //
                                                 //
void loop(){                                     //
     int a=enc_1.read();                         //  Читаем состояние 1 энкодера в переменную (a).
     int b=enc_2.read();                         //  Читаем состояние 2 энкодера в переменную (b).
                                                 //
     if( a || b ){                               //  Если хотя бы один из энкодеров зафиксировал поворот, то ...
         String txt=" ";                         //  Определяем строку для вывода в монитор.
         if( a==encLEFT  ){ txt+='<'; }else      //  Если 1 энкодер зафиксировал поворот влево,  добавляем символ '<'.
         if( a==encRIGHT ){ txt+='>'; }else      //  Если 1 энкодер зафиксировал поворот вправо, добавляем символ '>'.
                          { txt+='-'; }          //  Если 1 энкодер не зафиксировал поворот,     добавляем символ '-'.
                            txt+=" | ";          //
         if( b==encLEFT  ){ txt+='<'; }else      //  Если 2 энкодер зафиксировал поворот влево,  добавляем символ '<'.
         if( b==encRIGHT ){ txt+='>'; }else      //  Если 2 энкодер зафиксировал поворот вправо, добавляем символ '>'.
                          { txt+='-'; }          //  Если 2 энкодер не зафиксировал поворот,     добавляем символ '-'.
         Serial.println(txt);                    //
    }                                            //
}                                                //

// ПРИМЕЧАНИЕ:
// Вместо создания отдельных объектов: enc_1, enc_2,
// можно создать массив объектов и работать с ним в цикле,
// что сильно сократит количество строк скетча.
// См. пример "Array_Encoders".